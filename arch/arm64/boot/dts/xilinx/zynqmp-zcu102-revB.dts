// SPDX-License-Identifier: GPL-2.0+
/*
 * dts file for Xilinx ZynqMP ZCU102 RevB
 *
 * (C) Copyright 2016 - 2018, Xilinx, Inc.
 *
 * Michal Simek <michal.simek@xilinx.com>
 */

#include "zynqmp-zcu102-revA.dts"

/ {
	model = "ZynqMP ZCU102 RevB";
	compatible = "xlnx,zynqmp-zcu102-revB", "xlnx,zynqmp-zcu102", "xlnx,zynqmp";
};

    &gem3 {
        phy-handle = <&phy0>;
        phy0: phy0@1 {
            device_type = "ethernet-phy";
            reg = <1>;
        };
    };

};

