// SPDX-License-Identifier: GPL-2.0+
/*
 * dts file for Xilinx ZynqMP ZCU102 Rev1.0
 *
 * (C) Copyright 2016 - 2018, Xilinx, Inc.
 *
 * Michal Simek <michal.simek@xilinx.com>
 */

#include "zynqmp-zcu102-revB.dts"

/ {
	model = "ZynqMP ZCU102 Rev1.0";
	compatible = "xlnx,zynqmp-zcu102-rev1.0", "xlnx,zynqmp-zcu102", "xlnx,zynqmp";
};


&sdhci1 {
	/delete-property/ no-1-8-v;
};
